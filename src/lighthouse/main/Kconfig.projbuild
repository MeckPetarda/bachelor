## src/lighthouse/main/Kconfig.projbuild
```kconfig
menu "WiFi Configuration"
 
    config WIFI_SSID
        string "WiFi SSID"
        default "gogo O2"
        help
            SSID (network name) for the ESP32 to connect to.
            Must be a 2.4 GHz network (ESP32 does not support 5 GHz).
 
    config WIFI_PASSWORD
        string "WiFi Password"
        default "zssloup2"
        help
            WiFi password (WPA or WPA2) for the AP.
 
    config WIFI_MAXIMUM_RETRY
        int "Maximum retry attempts"
        default 5
        help
            Maximum number of connection retry attempts before giving up.
 
    config WIFI_SCAN_METHOD
        int "WiFi scan method"
        default 0
        help
            WiFi scan method:
            0 = WIFI_FAST_SCAN (connect to first match)
            1 = WIFI_ALL_CHANNEL_SCAN (scan all channels)
 
endmenu

menu "Hardware Configuration"

    config BATTERY_SENSE_ENABLED
        bool "Enable battery voltage sensing"
        default y
        help
            Enable ADC-based battery voltage monitoring on GPIO33 (ADC1_CH5).
            Disable for boards powered exclusively by USB with no battery connected
            (e.g., the USB-only development board).
            When disabled, all battery monitor functions return safe stub values
            and no ADC initialisation occurs.
            Set to 'n' in sdkconfig.defaults for USB-only board configurations.

endmenu
```
